// 2020 - electronstogo

#include <Wire.h>
#include "sh1106.h"
#include <ctype.h>




// oled pixel buffer
unsigned char oled_buffer[8][OLED_WIDTH] = {0x0};



// init sequence for the SH1106 controller.
const unsigned char SH1106_INIT_SEQUENCE[] PROGMEM = 
{  
	// deactivate screen
	0xAE,
	// lower/higher column address. 
	0x02, 0x10,
	// page address
	0xB0,
	// set contrast to max.
	0x81, 0xFF,
	// set segment re-map
	0xA1,
	// normal/reverse
	0xA6,
	// set multiplex ratio 63
	0xA8, 0x3F,
	// activate internal charge pump
	0xAD, 0x8B,
	0x33,
	// set com output scan mode direction
	0xC0,
	// set display offset 0
	0xD3, 0x0,
	// set display oscillator frquency
	0xD5, 0xF0,
	0xD9, 0x1F,
	// set com pins config
	0xDA, 0x12,
	// activate data from ram.
	//0xA4,
	0xDB, 0x40,
	// set display start line.
	0x40,
	// activate display
	0xAF,
};




const unsigned char CHAR_WIDTH_DATA[] PROGMEM =
{
	2, 1, 1, 1, 2, 1, 2, 2, 2, 2, 2, 1, 1, 1, 2, 2, 2, 2, 1, 1, 2, 2, 1, 1, 2, 1, 2, 2, 2, 1, 2, 2, 1, 2, 2, 2, 2, 2, 2, 1
};



const unsigned char FONT_TABLE[] PROGMEM = 
{
	0x3E, 0x00, //   #####  
	0x63, 0x00, //  ##   ## 
	0x61, 0x00, //  ##    # 
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	0xFF, // ########  
};






SH1106::SH1106(unsigned char sh1106_i2c_address)
{
	this->i2c_address = sh1106_i2c_address;

	// send init sequence to the SH1106 controller. 
	for(int i = 0; i < sizeof(SH1106_INIT_SEQUENCE); i++)
	{
		write_command(pgm_read_byte_near(SH1106_INIT_SEQUENCE + i));
	}
}


void SH1106::write_command(unsigned char command)
{
	Wire.beginTransmission(this->i2c_address);
	Wire.write(0x0);
	Wire.write(command);
	Wire.endTransmission();
}


void SH1106::write_data(unsigned char *data, unsigned data_length)
{	
	for(int i = 0; i < data_length; i++)
	{
		Wire.beginTransmission(this->i2c_address);
		Wire.write(0x40);	
		Wire.write(*data);
		Wire.endTransmission();
		data++;
	}
}

void SH1106::set_page(unsigned int page)
{
	write_command(0xb0 + page);
}


void SH1106::clear_oled_buffer()
{
	memset(oled_buffer, 0, 8 * OLED_WIDTH);
}


void SH1106::flush_oled_buffer()
{
	for(int i = 0; i < 8; i++)
	{
		this->set_page(i);
		this->write_data(oled_buffer[i], OLED_WIDTH);
	}
}


void SH1106::draw_point(unsigned int x, unsigned int y)
{
	// check if point is in valid area
	if(y >= OLED_HEIGHT || x >= OLED_WIDTH)
	{
		return;
	}

	oled_buffer[y / 8][x] |= (0x1 << (y % 8));
}




void SH1106::draw_letter(unsigned int x_pos, unsigned int y_pos, unsigned int char_index)
{
	unsigned char byte_buffer;
	
	// height of current char in bits.
	unsigned char height = 13;
	
	// width of the current char in byte (varies for every char).
	unsigned char width = pgm_read_byte_near(CHAR_WIDTH_DATA + char_index); 
	
	// table byte offset, where we can find the current char.
	unsigned int char_table_offset = 0;
	
	
	// caculate the offset of char data in the table.
	for(int i = 0; i < char_index; i++)
	{
		char_table_offset += pgm_read_byte_near(CHAR_WIDTH_DATA + i)  * height;
	}
	
	
	// loop through all bytes, and set the pixels in the OLED display buffer.
	for(int i = 0; i < height; i++)
	{
		for(int j = 0; j < width; j++)
		{
			byte_buffer = pgm_read_byte_near(FONT_TABLE + char_table_offset + i * width + j);
			
			for(int bit_pos = 0; bit_pos < 8; bit_pos++)
			{
				if(byte_buffer & (0x1 << (7 - bit_pos)))
				{
					this->draw_point(x_pos + bit_pos + j * 8, y_pos - i);
				}
			}
		}
	}
}



// Draws the given string at the x and y position on the OLED display.
void SH1106::draw_string(unsigned int x_pos, unsigned int y_pos, unsigned char *string)
{
	unsigned int letter_index;
	unsigned int while_loop_counter = 0;
	unsigned int x_pos_new;
	

	while(*string)
	{
		// get the letter index in the font table.
		if(isdigit(*string))
		{
			letter_index = *string - '0';
			x_pos_new = x_pos + 12;
		}
		else if(isupper(*string))
		{
			letter_index = (unsigned int)(*string - 'A' + 14);
			
			// add some space between the letters
			x_pos_new = x_pos + 14;
			
			// some letters need specific space.
			if(*string == 'M')
			{
				x_pos_new += 5;
			}
			else if(*string == 'W')
			{
				x_pos_new += 5;
			}
			else if(*string == 'I')
			{
				x_pos_new -= 6;
			}
			else if(*string == 'S')
			{
				x_pos_new -= 3;
			}
			else if(*string == 'E')
			{
				x_pos_new -= 3;
			}
			else if(*string == 'P')
			{
				x_pos_new -= 3;
			}
			else if(*string == 'L')
			{
				x_pos_new -= 3;
			}
			
		}
		else if(*string == ' ')
		{
			x_pos = x_pos + 5;
			string++;
			continue;	
		}
		else if(*string == '%')
		{
			letter_index = 10;
			x_pos_new = x_pos + 18;
		}
		else if(*string == '.')
		{
			letter_index = 11;
			x_pos_new = x_pos + 6;
		}
		else if(*string == ':')
		{
			letter_index = 12;
			x_pos_new = x_pos + 6;
		}
		else if(*string == '$') // '°'
		{
			letter_index = 13;
			x_pos_new = x_pos + 7;
		}
		else
		{
			// couldnt find letter index in the font table.
			string++;
			continue;
		}	

		this->draw_letter(x_pos, y_pos, letter_index);
		x_pos = x_pos_new;
	
	
		string++;
		while_loop_counter++;
		
		// watchdog that breaks in case of too long strings.
		// strings can become very long, when the '\0' char at the end is missing.
		if(while_loop_counter > 10)
		{
			break;
		}
	}



}
